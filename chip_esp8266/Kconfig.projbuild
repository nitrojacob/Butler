## chip_esp8266/Kconfig.projbuild
```kconfig
menu "Custom Configs"

    config POP
        string "Proof-of-possession"
        default "abcd1234"

    config RESET_PROVISIONED
        bool
        default n
        prompt "Reset provisioned status of the device"
        help
            This erases the NVS to reset provisioned status of the device on every reboot.
            Provisioned status is determined by the Wi-Fi STA configuration, saved on the NVS.

endmenu
```
